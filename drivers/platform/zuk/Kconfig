## drivers/platform/zuk/Kconfig
```kconfig
# Zuk configuration options

config MACH_ZUK
	bool "Zuk device"
	depends on ARCH_MSM
	help
	  Support for Zuk products

config MACH_ZUK_MSM8996
	bool "Zuk MSM8996"
	depends on ARCH_MSM8996
	select MACH_ZUK
	help
	  Support for MSM8996 Zuk variants

menu "Zuk board selection"

	config MACH_ZUK_Z2
		bool "Zuk Z2_board"
		select MACH_ZUK_MSM8996
		help
		  Support for Zuk Z2 variant

endmenu
```
